## sdkconfig.defaults.esp32p4
```kconfig
CONFIG_IDF_TARGET="esp32p4"
CONFIG_ESPTOOLPY_FLASHSIZE_32MB=y
CONFIG_ESPTOOLPY_FLASHMODE_QIO=y

CONFIG_SPIRAM=y
CONFIG_SPIRAM_SPEED_200M=y
CONFIG_SPIRAM_XIP_FROM_PSRAM=y
CONFIG_ESP_MAIN_TASK_STACK_SIZE=10240
CONFIG_FREERTOS_HZ=1000
CONFIG_FREERTOS_VTASKLIST_INCLUDE_COREID=y
CONFIG_FREERTOS_GENERATE_RUN_TIME_STATS=y

CONFIG_SPIRAM_MALLOC_ALWAYSINTERNAL=4096
CONFIG_SPIRAM_MALLOC_RESERVE_INTERNAL=65536
CONFIG_SPIRAM_TRY_ALLOCATE_WIFI_LWIP=n
CONFIG_SPIRAM_MEMTEST=n
CONFIG_MBEDTLS_EXTERNAL_MEM_ALLOC=n

CONFIG_SLAVE_IDF_TARGET_ESP32C6=y

CONFIG_SR_WN_WN9_NIHAOXIAOZHI_TTS=y

CONFIG_IDF_EXPERIMENTAL_FEATURES=y

CONFIG_COMPILER_OPTIMIZATION_SIZE=y

CONFIG_ESP_VIDEO_ENABLE_ISP_PIPELINE_CONTROLLER=y
CONFIG_USB_HOST_CONTROL_TRANSFER_MAX_SIZE=1024

# LVGL Graphics
CONFIG_LV_USE_SNAPSHOT=y
CONFIG_LV_USE_GIF=y

# 以下配置来自 main/boards/dooirobot/config.json 的 sdkconfig_append
# （原本只有 scripts/release.py 会读取，本仓库无该脚本，故固化到 defaults 中，
#   保证 idf.py fullclean build 后依然生效）
# 已由本文件既有的 FLASHSIZE_32MB / PARTITION_TABLE_CUSTOM_FILENAME 覆盖的项不再重复。

# WebSocket（网页遥控）
CONFIG_HTTPD_WS_SUPPORT=y

# 唤醒词：Multinet 自定义唤醒词
CONFIG_SR_MN_CN_MULTINET7_QUANT=y
CONFIG_USE_CUSTOM_WAKE_WORD=y
CONFIG_CUSTOM_WAKE_WORD="ni hao du yi"
CONFIG_CUSTOM_WAKE_WORD_DISPLAY="你好,嘟以"

# 蓝牙（经 esp_hosted 使用 C6 的 BT）
CONFIG_ESP_HOSTED_ENABLE_BT_NIMBLE=y
CONFIG_UART_HW_FLOWCTRL_DISABLE=y
CONFIG_BT_ENABLED=y
CONFIG_BT_NIMBLE_ENABLED=y
CONFIG_BT_NIMBLE_TRANSPORT_UART=n
CONFIG_BT_NIMBLE_MEM_ALLOC_MODE_EXTERNAL=y

# P4 <-> C6 SDIO（WiFi 依赖）
CONFIG_IDF_SLAVE_TARGET="esp32c6"
CONFIG_ESP_SDIO_GPIO_RESET_SLAVE=42
CONFIG_ESP_SDIO_PIN_CMD=48
CONFIG_ESP_SDIO_PIN_CLK=47
CONFIG_ESP_SDIO_PIN_D0=46
CONFIG_ESP_SDIO_PIN_D2=44
CONFIG_ESP_SDIO_PIN_D3=43
CONFIG_ESP_SDIO_PIN_D1=45
CONFIG_ESP_HOSTED_PRIV_SDIO_PIN_CMD_SLOT_1=48
CONFIG_ESP_HOSTED_PRIV_SDIO_PIN_CLK_SLOT_1=47
CONFIG_ESP_HOSTED_PRIV_SDIO_PIN_D0_SLOT_1=46
CONFIG_ESP_HOSTED_PRIV_SDIO_PIN_D1_4BIT_BUS_SLOT_1=45
CONFIG_ESP_HOSTED_PRIV_SDIO_PIN_D2_4BIT_BUS_SLOT_1=44
CONFIG_ESP_HOSTED_PRIV_SDIO_PIN_D3_4BIT_BUS_SLOT_1=43
CONFIG_ESP_HOSTED_SDIO_PIN_CMD=48
CONFIG_ESP_HOSTED_SDIO_PIN_CLK=47
CONFIG_ESP_HOSTED_SDIO_PIN_D0=46
CONFIG_ESP_HOSTED_SDIO_PRIV_PIN_D1_4BIT_BUS=45
CONFIG_ESP_HOSTED_SDIO_PIN_D2=44
CONFIG_ESP_HOSTED_SDIO_PIN_D3=43
CONFIG_ESP_HOSTED_SDIO_PIN_D1=45

# 控制台 / 音频处理
CONFIG_ESP_CONSOLE_USB_SERIAL_JTAG=y
CONFIG_USE_DEVICE_AEC=y

# 摄像头
CONFIG_CAMERA_OV5647=y
CONFIG_CAMERA_OV5647_AUTO_DETECT_MIPI_INTERFACE_SENSOR=y
CONFIG_CAMERA_OV5647_MIPI_RAW8_800X800_50FPS=y

# Flash（32MB，Boya 颗粒，32 位地址）
CONFIG_SOC_SPI_MEM_SUPPORT_CACHE_32BIT_ADDR_MAP=y
CONFIG_SPI_FLASH_32BIT_ADDR_ENABLE=y
CONFIG_SPI_FLASH_QUAD_32BIT_ADDR_ENABLE=y
CONFIG_SPI_FLASH_SUPPORT_BOYA_CHIP=y
CONFIG_SPI_FLASH_SUPPORT_GD_CHIP=n

# 其他
CONFIG_SPIFFS_OBJ_NAME_LEN=64
CONFIG_LWIP_MAX_SOCKETS=20

# ESP32-P4 芯片版本（兼容 rev < 3 的老批次）
CONFIG_ESP32P4_SELECTS_REV_LESS_V3=y
CONFIG_ESP32P4_REV_MIN_100=y
CONFIG_ESP32P4_REV_MIN_FULL=100
CONFIG_ESP_REV_MIN_FULL=100
```
